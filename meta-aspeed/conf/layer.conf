## meta-aspeed/conf/layer.conf
```bitbake
# We have a conf and classes directory, add to BBPATH
BBPATH .= ":${LAYERDIR}"

BBFILES += "${LAYERDIR}/recipes-*/*/*.bb \
            ${LAYERDIR}/recipes-*/*/*.bbappend"

BBFILE_COLLECTIONS += "aspeed-layer"
BBFILE_PATTERN_aspeed-layer := "^${LAYERDIR}/"
LAYERSERIES_COMPAT_aspeed-layer = "dunfell gatesgarth"
```

## meta-aspeed/conf/local.conf.sample
```bitbake
#MACHINE ?= "evb-ast2500"
#MACHINE ??= "evb-ast2600"
MACHINE ??= "ast2600evb"
DISTRO ?= "openbmc-ast2600evb
# Allow logging in if the user does not set the root password.
EXTRA_IMAGE_FEATURES ?= "debug-tweaks"
```

## meta-evb/meta-evb-aspeed/conf/bblayers.conf.sample
```bitbake
BBPATH = "${TOPDIR}"
BBFILES ?= ""

BBLAYERS ?= " \
  ##OEROOT##/meta \
  ##OEROOT##/meta-openembedded/meta-oe \
  ##OEROOT##/meta-openembedded/meta-networking \
  ##OEROOT##/meta-openembedded/meta-perl \
  ##OEROOT##/meta-openembedded/meta-python \
  ##OEROOT##/meta-phosphor \
  ##OEROOT##/meta-aspeed \
  ##OEROOT##/meta-x86 \
  ##OEROOT##/meta-evb \
  ##OEROOT##/meta-evb/meta-evb-aspeed \
  "
BBLAYERS_NON_REMOVABLE ?= " \
  ##OEROOT##/meta \
  ##OEROOT##/meta-openembedded/meta-oe \
  ##OEROOT##/meta-openembedded/meta-networking \
  ##OEROOT##/meta-openembedded/meta-perl \
  ##OEROOT##/meta-openembedded/meta-python \
  ##OEROOT##/meta-phosphor \
  ##OEROOT##/meta-aspeed \
  ##OEROOT##/meta-x86 \
  ##OEROOT##/meta-evb \
  ##OEROOT##/meta-evb/meta-evb-aspeed \
  "
```

## meta-evb/meta-evb-aspeed/conf/layer.conf
```bitbake
# We have a conf and classes directory, add to BBPATH
BBPATH .= ":${LAYERDIR}"

BBFILES += "${LAYERDIR}/recipes-*/*/*.bb \
            ${LAYERDIR}/recipes-*/*/*.bbappend"

BBFILE_COLLECTIONS += "evb-aspeed-layer"
BBFILE_PATTERN_evb-aspeed-layer := "^${LAYERDIR}/"
LAYERSERIES_COMPAT_evb-aspeed-layer = "dunfell gatesgarth"
```

## meta-evb/meta-evb-aspeed/conf/machine/ast2600evb.conf
```bitbake
KERNEL_DEVICETREE = "aspeed-ast2600-evb.dtb"
UBOOT_MACHINE = "ast2600_openbmc_spl_emmc_defconfig"
UBOOT_DEVICETREE = "ast2600a1-evb"
SPL_BINARY = "spl/u-boot-spl.bin"

require conf/machine/include/ast2600.inc
require conf/machine/include/obmc-bsp-common.inc
require conf/distro/include/phosphor-mmc.inc

SERIAL_CONSOLES = "115200;ttyS4"
IMAGE_FEATURES_remove = "obmc-ikvm"
```
